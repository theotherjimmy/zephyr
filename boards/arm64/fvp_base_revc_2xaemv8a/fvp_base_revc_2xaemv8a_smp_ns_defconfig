## boards/arm64/fvp_base_revc_2xaemv8a/fvp_base_revc_2xaemv8a_smp_ns_defconfig
```kconfig
# Copyright (c) 2022 Arm Limited (or its affiliates). All rights reserved.
# SPDX-License-Identifier: Apache-2.0

CONFIG_SOC_SERIES_FVP_AEMV8A=y
CONFIG_SOC_FVP_BASE_REVC_2XAEMV8A=y
CONFIG_BOARD_FVP_BASE_REVC_2XAEMV8A=y

CONFIG_XIP=n

CONFIG_THREAD_STACK_INFO=y

# Enable Timer and Sys clock
CONFIG_SYS_CLOCK_TICKS_PER_SEC=1000
CONFIG_ARM_ARCH_TIMER=y

# Enable UART driver
CONFIG_SERIAL=y

# Enable serial port
CONFIG_UART_PL011=y
CONFIG_UART_INTERRUPT_DRIVEN=y

# Enable console
CONFIG_CONSOLE=y
CONFIG_UART_CONSOLE=y

# Enable TFA
CONFIG_ARMV8_A_NS=y
CONFIG_BUILD_WITH_TFA=y
CONFIG_TFA_MAKE_BUILD_TYPE_DEBUG=y

# Enable SMP
CONFIG_SMP=y
CONFIG_MP_NUM_CPUS=4
CONFIG_CACHE_MANAGEMENT=y
CONFIG_TIMEOUT_64BIT=y
CONFIG_SOC_FVP_AEMV8A_EL2_INIT=y
CONFIG_MAX_THREAD_BYTES=3

# PSCI is supported
CONFIG_PM_CPU_OPS=y
CONFIG_PM_CPU_OPS_PSCI=y
```

## boards/arm64/fvp_corstone1000_a35/Kconfig.board
```kconfig
# Copyright (c) 2021 Carlo Caione <ccaione@baylibre.com>
# SPDX-License-Identifier: Apache-2.0

config BOARD_FVP_CORSTONE1000_A35
	bool "FVP Base RevC AEMv8A simulation board"
	depends on SOC_FVP_CORSTONE1000_A35
```

## boards/arm64/fvp_corstone1000_a35/Kconfig.defconfig
```kconfig
# Copyright (c) 2021 Carlo Caione <ccaione@baylibre.com>
# SPDX-License-Identifier: Apache-2.0

if BOARD_FVP_CORSTONE1000_A35

config BUILD_OUTPUT_BIN
	default y

config BOARD
	default "fvp_corstone1000_a35"

config ROM_START_OFFSET
	default 0x1000

endif # BOARD_FVP_BASE_REVC_2XAEMV8A
```

## boards/arm64/fvp_corstone1000_a35/fvp_corstone1000_a35_defconfig
```kconfig
# Copyright (c) 2021 Carlo Caione <ccaione@baylibre.com>
# SPDX-License-Identifier: Apache-2.0

CONFIG_SOC_SERIES_FVP_CORSTONE1000_A35=y
CONFIG_SOC_FVP_CORSTONE1000_A35=y
CONFIG_BOARD_FVP_CORSTONE1000_A35=y

CONFIG_FLASH_SIZE=0

CONFIG_THREAD_STACK_INFO=y

# Enable Timer and Sys clock
CONFIG_SYS_CLOCK_TICKS_PER_SEC=1000
CONFIG_ARM_ARCH_TIMER=y

# Enable UART driver
CONFIG_SERIAL=y

# Enable serial port
CONFIG_UART_PL011=y
CONFIG_UART_INTERRUPT_DRIVEN=y

# Enable console
CONFIG_CONSOLE=y
CONFIG_UART_CONSOLE=y

# Force TFM

CONFIG_BUILD_WITH_TFM=y
CONFIG_TFM_IPC=y
CONFIG_TFM_BL2=y
CONFIG_TFM_PLATFORM_IS_FVP=y
CONFIG_ARMV8_A_NS=y
```

## modules/trusted-firmware-a/Kconfig
```kconfig
# Copyright (c) 2022 Arm Limited (or its affiliates). All rights reserved.
# SPDX-License-Identifier: Apache-2.0

config ZEPHYR_TRUSTED_FIRMWARE_A_MODULE
	bool

menuconfig BUILD_WITH_TFA
	bool "Build with TF-A as the Secure Execution Environment"
	help
	  When enabled, this option instructs the Zephyr build process to
	  additionally generate a TF-A image for the Secure Execution
	  environment, along with the Zephyr image. The Zephyr image
	  itself is to be executed in the Non-Secure Processing Environment.

if BUILD_WITH_TFA

config TFA_MAKE_BUILD_TYPE_DEBUG
	bool "Debug build"
	help
	  When enabled, the build type of TF-A would be debug.

config TFA_PLAT
	string "The platform to build TF-A for"
	default "corstone1000" if BOARD_FVP_CORSTONE1000_A35
	default "fvp"

config TFA_TARGET_PLATFORM
	string "The sub-platform for a target, if that is needed"
	default "fvp" if BOARD_FVP_CORSTONE1000_A35

config TFA_PIE
	bool "Enable position independent code for the builtin TF-A"
	default false

config TFA_BL2_AT_EL3
	bool "Configure TF-A's BL2 to run at EL3"
	default false

endif # BUILD_WITH_TFA
```

## soc/arm64/arm/fvp_aemv8a/Kconfig.soc
```kconfig
# Copyright (c) 2021 Carlo Caione <ccaione@baylibre.com>
# SPDX-License-Identifier: Apache-2.0

choice
	prompt "ARM FVP AEMv8A AArch64 SoCs"
	depends on SOC_SERIES_FVP_AEMV8A

config SOC_FVP_BASE_REVC_2XAEMV8A
	bool "ARM FVP Base RevC 2xAEMv8A AArch64 simulation"
	select CPU_CORTEX_A53
	select GIC_V3

endchoice

config SOC_FVP_AEMV8A_EL2_INIT
	bool "ARM FVP AEMv8A EL2 Initialization"
	default n
	help
	  Initialize MPIDR_EL1 in z_arm64_el2_plat_init. It's necessary
	  when zephyr starts at EL2 on multiprocessor systems.
```

## soc/arm64/arm/fvp_corstone1000/Kconfig.series
```kconfig
# Copyright (c) 2021 Carlo Caione <ccaione@baylibre.com>
# SPDX-License-Identifier: Apache-2.0

config SOC_SERIES_FVP_CORSTONE1000_A35
	bool "ARM FVP AEMv8A AArch64 Series"
	select ARM64
	select CPU_CORTEX
	select CPU_CORTEX_A
	select CPU_HAS_MMU
	select SOC_FAMILY_ARM64
	help
	  Enable support for ARM FVP AEMv8A AArch64 Series
```

## soc/arm64/arm/fvp_corstone1000/Kconfig.soc
```kconfig
# Copyright (c) 2021 Carlo Caione <ccaione@baylibre.com>
# SPDX-License-Identifier: Apache-2.0

choice
	prompt "ARM FVP AEMv8A AArch64 SoCs"
	depends on SOC_SERIES_FVP_CORSTONE1000_A35

config SOC_FVP_CORSTONE1000_A35
	bool "ARM FVP Corstone 1000 A35 AArch64 simulation"
	select CPU_CORTEX_A35
	select GIC_V2

endchoice
```

## tests/arch/arm64/arm64_svc_call/Kconfig
```kconfig
# Copyright (c) 2022 Arm Limited (or its affiliates). All rights reserved.
# SPDX-License-Identifier: Apache-2.0

config SVC_CALL_USE_HVC
	bool "Set svc call method to hvc"
	default n

source "Kconfig.zephyr"
```

## tests/arch/arm64/arm64_svc_call/testcase.yaml
```yaml
tests:
  arch.arm64.svc_call.smc:
    arch_allow: arm
    tags: arm drivers userspace
    filter: CONFIG_BUILD_WITH_TFA
  arch.arm64.svc_call.hvc:
    arch_allow: arm
    tags: arm drivers userspace
    filter: CONFIG_BUILD_WITH_TFA
    extra_configs:
      - CONFIG_SVC_CALL_USE_HVC=y
```
